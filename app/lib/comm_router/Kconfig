## app/lib/comm_router/Kconfig
```kconfig
config COMM_ROUTER
	bool "Communication router library"
	default n
	help
	  Enable the transport-neutral communication message router.

if COMM_ROUTER

config COMM_ROUTER_MAX_PAYLOAD
	int "Maximum communication router payload size"
	range 1 1024
	default 64
	help
	  Maximum payload size accepted by the communication router.

endif
```

## app/lib/commander/Kconfig
```kconfig
config COMMANDER
	bool "Commander library"
	default n
	select COMM_ROUTER
	help
	  Enable the commander library.

if COMMANDER

config COMMANDER_EVENT_QUEUE_SIZE
	int "Commander event queue size"
	range 1 10
	default 3
	help
	  Maximum number of pending command and acknowledgement events.

endif
```

## app/lib/motor/Kconfig
```kconfig
config MOTOR_THREAD_PRIORITY
	int "Motor thread priority"
	default -5
	help
		Priority used for the motor control thread.

config MOTOR_THREAD_STACK_SIZE
	int "Motor thread stack size"
	default 1024
	help
		Stack size used by the motor control thread.

config MOTOR_LOOP_PERIOD_US
	int "Motor loop period in microseconds"
	default 1000
	help
		Period used by the motor control loop.

choice MOTOR_ARITHMETIC_IMPLEMENTATION
	prompt "Arithmetic implementation"
	default MOTOR_ARITHMETIC_CORDIC if SOC_SERIES_STM32G4X
	default MOTOR_ARITHMETIC_CMSIS_DSP if ARM
	default MOTOR_ARITHMETIC_SOFTWARE
	help
		Select the arithmetic implementation used by the motor control loop.

config MOTOR_ARITHMETIC_CORDIC
	bool "STM32G4 CORDIC"
	depends on SOC_SERIES_STM32G4X

config MOTOR_ARITHMETIC_CMSIS_DSP
	bool "CMSIS-DSP"
	depends on ARM
	select CMSIS_DSP
	select CMSIS_DSP_CONTROLLER

config MOTOR_ARITHMETIC_SOFTWARE
	bool "Software"

endchoice
```

## app/lib/telemetry/Kconfig
```kconfig
config TELEMETRY
	bool "Telemetry library"
	default n
	select COMM_ROUTER
	help
	  Enable the telemetry thread and library.

if TELEMETRY

config TELEMETRY_THREAD_PRIORITY
	int "Telemetry thread priority"
	default 5
	help
	  Priority used for the telemetry thread

config TELEMETRY_THREAD_STACK_SIZE
	int "Telemetry thread stack size"
	default 1024

endif
```

## app/lib/uart_transport/Kconfig
```kconfig
config UART_TRANSPORT
	bool "UART transport adapter"
	select COMM_ROUTER
	select CRC
	select SERIAL
	default n
	help
	  Enable the UART transport adapter for the communication router.

if UART_TRANSPORT

choice UART_TRANSPORT_BACKEND
	prompt "UART transport backend"
	default UART_TRANSPORT_STM32 if SOC_FAMILY_STM32 && SERIAL_SUPPORT_ASYNC
	default UART_TRANSPORT_GENERIC

config UART_TRANSPORT_GENERIC
	bool "Zephyr interrupt-driven UART"
	depends on SERIAL_SUPPORT_INTERRUPT
	select UART_INTERRUPT_DRIVEN
	select UART_TRANSPORT_GENERIC_API

config UART_TRANSPORT_STM32
	bool "STM32 Zephyr asynchronous UART"
	depends on SOC_FAMILY_STM32 && SERIAL_SUPPORT_ASYNC
	select UART_ASYNC_API
	select UART_TRANSPORT_STM32_API

endchoice

config UART_TRANSPORT_GENERIC_API
	bool

config UART_TRANSPORT_GENERIC_RX_QUEUE_DEPTH
	int "Generic UART RX queue depth"
	depends on UART_TRANSPORT_GENERIC
	range 1 16
	default 4

config UART_TRANSPORT_GENERIC_TX_TIMEOUT_MS
	int "Generic UART TX timeout"
	depends on UART_TRANSPORT_GENERIC
	range 1 10000
	default 1000

config UART_TRANSPORT_STM32_API
	bool

config UART_TRANSPORT_STM32_RX_BUFFER_SIZE
	int "STM32 UART DMA RX buffer size"
	depends on UART_TRANSPORT_STM32
	range 32 4096
	default 256

config UART_TRANSPORT_STM32_RX_QUEUE_DEPTH
	int "STM32 UART RX queue depth"
	depends on UART_TRANSPORT_STM32
	range 1 16
	default 4

config UART_TRANSPORT_STM32_RX_TIMEOUT_US
	int "STM32 UART RX inactivity timeout in microseconds"
	depends on UART_TRANSPORT_STM32
	range 1 1000000
	default 1000

config UART_TRANSPORT_STM32_TX_TIMEOUT_MS
	int "STM32 UART blocking TX timeout"
	depends on UART_TRANSPORT_STM32
	range 1 10000
	default 100

endif
```

## tests/Kconfig
```kconfig
mainmenu "Communication router tests"

source "Kconfig.zephyr"
rsource "../app/lib/commander/Kconfig"
rsource "../app/lib/comm_router/Kconfig"
rsource "../app/lib/uart_transport/Kconfig"
```

## tests/testcase.yaml
```yaml
tests:
  comm_router.core:
    platform_allow:
      - native_sim
    tags:
      - comm_router
```
