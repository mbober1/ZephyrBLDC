## CMakeLists.txt
```
# SPDX-License-Identifier: Apache-2.0

cmake_minimum_required(VERSION 3.20.0)

set(BOARD_ROOT ${CMAKE_CURRENT_SOURCE_DIR}/../..)

find_package(Zephyr REQUIRED HINTS $ENV{ZEPHYR_BASE})
project(calibration_app)

add_subdirectory(../../app/lib/motor/arithmetic arithmetic)
add_subdirectory(../../app/lib/motor/calibration calibration)
add_subdirectory(../../app/lib/motor/params motor_params)

target_sources(app PRIVATE src/main.c)
target_link_libraries(app PRIVATE calibration motor_params)
```

## Kconfig
```
source "Kconfig.zephyr"

rsource "../../app/lib/motor/Kconfig"
```

## prj.conf
```kconfig
CONFIG_SENSOR=y
CONFIG_SENSOR_ASYNC_API=y
CONFIG_SPI_RTIO=y
CONFIG_SPINNER_FEEDBACK=y
CONFIG_SPINNER_FEEDBACK_RTIO=y
CONFIG_MT6701_STREAM_PERIOD_MS=10
CONFIG_SPINNER_FEEDBACK_RTIO_SAMPLE_PERIOD_MS=10
# CONFIG_SPINNER_FILTER_LOW_PASS=y
# CONFIG_SPINNER_FILTER_LOW_PASS_BIQUAD=y

CONFIG_SERIAL=y
CONFIG_UART_CONSOLE=y
CONFIG_PRINTK=y
CONFIG_CONSOLE=y
CONFIG_LOG=y

CONFIG_SPINNER_CURRSMP=y
CONFIG_SPINNER_SVPWM=y
CONFIG_SPINNER_SVM=y
CONFIG_SPINNER_UTILS_STM32=y
CONFIG_CMSIS_DSP_COMPLEXMATH=y
CONFIG_SPINNER_SVPWM_STM32=y
CONFIG_BLDC=y
CONFIG_DRV83XX=y

CONFIG_FPU=y
CONFIG_SPINNER_CURRSMP_FILTER_LOW_PASS=y

CONFIG_FLASH=y
CONFIG_FLASH_MAP=y
CONFIG_ZMS=y
CONFIG_SETTINGS=y
CONFIG_SETTINGS_ZMS=y
CONFIG_CRC=y
CONFIG_ZMS_LOG_LEVEL_ERR=y
```

## boards/microspora.overlay
```dts
#include "../../../boards/storage_partition.dtsi"
#include "../../../boards/microspora.dtsi"

/ {
	chosen {
		zephyr,console = &usart3;
	};

};
```

## src/main.c
```c
#include <math.h>
#include <stdio.h>

#include <zephyr/device.h>
#include <zephyr/devicetree.h>
#include <zephyr/kernel.h>
#include <zephyr/settings/settings.h>

#include <spinner/drivers/currsmp.h>
#include <spinner/drivers/svpwm.h>

#include "motor_params.h"
#include "calibration.h"

#define BUS_VOLTAGE_V    (9.0f)
#define RESISTANCE_SAMPLES (50)
#define POLE_PAIR_STEPS (1000)
#define POLE_PAIR_MAX (40)

void calibration_regulation_cb(void *ctx) {}

int main(void)
{
	const struct device *motor = DEVICE_DT_GET(DT_NODELABEL(svpwm));
	const struct device *currsmp = DEVICE_DT_GET(DT_NODELABEL(currsmp));
	const struct device *feedback = DEVICE_DT_GET(DT_NODELABEL(feedback));
	float pole_pairs;
	int pole_pairs_int;
	float offset;
	int offset_int;
	float resistance;
	float inductance;
	enum motor_direction dir;
	struct motor_params params;

	if (!device_is_ready(motor) || !device_is_ready(currsmp) ||
	    !device_is_ready(feedback)) {
		printf("Calibration devices are not ready\n");
		return 0;
	}

	currsmp_configure(currsmp, calibration_regulation_cb, (void *)currsmp);
	currsmp_start(currsmp);
	svpwm_start(motor);
	
	resistance = measure_phase_resistance(motor, currsmp, BUS_VOLTAGE_V, RESISTANCE_SAMPLES);
	if (isnan(resistance)) {
		printf("Phase resistance measurement failed\n");
		return 0;
	}
	else
	{
		printf("phase resistance: %.4f ohm\n", (double)resistance);
	}

	pole_pairs = measure_pole_pairs(motor, feedback, POLE_PAIR_STEPS);
	if (isnan(pole_pairs)) {
		printf("Pole pairs measurement failed\n");
		return 0;
	}
	else if (pole_pairs < 0.0f) {
		pole_pairs *= -1.0f;
		dir = MOTOR_DIR_CLOCKWISE;
	} else {
		dir = MOTOR_DIR_COUNTERCLOCKWISE;
	}
	pole_pairs_int = (int)(pole_pairs + 0.5f);

	if (pole_pairs_int > POLE_PAIR_MAX) {
		printf("Pole pairs measurement failed\n");
		return 0;
	}
	else
	{
		printf("pole pairs: %d (%.3f)\n", pole_pairs_int, (double)pole_pairs);
	}


	offset = measure_phase_offset(motor, feedback, pole_pairs_int);
	if (isnan(offset)) {
		printf("Phase offset measurement failed\n");
		return 0;
	}
	else
	{
		offset_int = (int)(offset + 0.5f);
		printf("phase offset: %d (%.2f deg)\n", offset_int, (double)offset);
	}

	deenergize_motor(motor);


	if (settings_subsys_init() != 0) {
		printf("Settings init failed\n");
		return 0;
	}

	params.pole_pairs = pole_pairs_int;
	params.phase_offset_deg = offset_int;
	params.dir = dir;
	if (motor_params_save(&params) != 0) {
		printf("Calibration save failed\n");
	}
	else {
		printf("Calibration saved\n");
	}


	return 0;
}
```

## src/calib_store.c
```c
#include <stdint.h>

#include <zephyr/settings/settings.h>

#include "calib_store.h"

int calib_store_save(const struct calib_data *data)
{
	return settings_save_one("calib/data", data, sizeof(*data));
}
```

## src/calib_store.h
```c
#ifndef CALIB_STORE_H_
#define CALIB_STORE_H_

#include <stdint.h>

enum direction {
	CLOCKWISE,
	COUNTERCLOCKWISE
};

struct calib_data {
	float resistance;
	int32_t pole_pairs;
	int32_t phase_offset;
	int32_t dir;
};

int calib_store_save(const struct calib_data *data);

#endif
```
