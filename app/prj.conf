## CMakeLists.txt
```
# SPDX-License-Identifier: Apache-2.0

cmake_minimum_required(VERSION 3.20.0)

set(BOARD_ROOT ${CMAKE_CURRENT_SOURCE_DIR}/..)

find_package(Zephyr REQUIRED HINTS $ENV{ZEPHYR_BASE})
project(bldc_app)

target_sources(app PRIVATE src/main.c)

if(CONFIG_COMMANDER)
	add_subdirectory(lib/commander)
	add_dependencies(commander zephyr_generated_headers)
	target_link_libraries(app PRIVATE commander)
endif()

if(CONFIG_DT_HAS_ST_STM32_SVPWM_ENABLED)
	add_subdirectory(lib/motor)
	add_dependencies(motor zephyr_generated_headers)
	target_link_libraries(app PRIVATE motor)
	if(CONFIG_COMMANDER)
		target_link_libraries(motor PRIVATE commander)
	endif()
endif()

if(CONFIG_COMM_ROUTER)
	add_subdirectory(lib/comm_router)
	target_link_libraries(app PRIVATE comm_router)
endif()

if(CONFIG_UART_TRANSPORT)
	add_subdirectory(lib/uart_transport)
	target_link_libraries(app PRIVATE uart_transport)
endif()

if(CONFIG_TELEMETRY)
	add_subdirectory(lib/telemetry)
	target_link_libraries(app PRIVATE telemetry)
endif()
```

## Kconfig
```
source "Kconfig.zephyr"

rsource "lib/commander/Kconfig"
rsource "lib/telemetry/Kconfig"
rsource "lib/comm_router/Kconfig"
rsource "lib/uart_transport/Kconfig"
rsource "lib/motor/Kconfig"
```

## prj.conf
```kconfig
CONFIG_COMMANDER=y
CONFIG_TELEMETRY=y
CONFIG_UART_TRANSPORT=y

CONFIG_SENSOR=y
CONFIG_SENSOR_ASYNC_API=y
CONFIG_SPINNER_CURRSMP=y
CONFIG_SPINNER_SVPWM=y
CONFIG_SPINNER_SVPWM_STM32=y
CONFIG_FPU=y
CONFIG_BLDC=y
CONFIG_DRV83XX=y

# Encoder configuration
CONFIG_SPINNER_FEEDBACK=y
CONFIG_SPINNER_FEEDBACK_RTIO=y
CONFIG_MT6701_STREAM_PERIOD_MS=30
CONFIG_SPINNER_FEEDBACK_RTIO_SAMPLE_PERIOD_MS=30
CONFIG_SPINNER_FILTER_LOW_PASS=y
CONFIG_SPINNER_FILTER_LOW_PASS_BIQUAD=y
CONFIG_SPINNER_CURRSMP_FILTER_LOW_PASS=y
CONFIG_CRC=y

# CONFIG_UART_TRANSPORT_STM32=n #broken
```

## boards/microspora.conf
```kconfig
CONFIG_FLASH=y
CONFIG_FLASH_MAP=y
CONFIG_ZMS=y
CONFIG_SETTINGS=y
CONFIG_SETTINGS_ZMS=y
CONFIG_LOG=y
```

## boards/microspora.overlay
```dts
#include "../../boards/storage_partition.dtsi"
#include "../../boards/microspora.dtsi"
```

## boards/native_sim.overlay
```dts
&uart1 {
	status = "okay";
};

/ {
	aliases {
		comm = &uart1;
	};
};
```

## src/main.c
```c
#include <zephyr/logging/log.h>
#include <zephyr/kernel.h>

LOG_MODULE_REGISTER(app, LOG_LEVEL_INF);

#if defined(CONFIG_UART_TRANSPORT)
#include <uart_transport.h>
UART_TRANSPORT_DEFINE(comm_uart_transport, &uart_transport_backend_api, DEVICE_DT_GET(DT_ALIAS(comm)));
#endif

#if defined(CONFIG_TELEMETRY)
#include <telemetry.h>
K_THREAD_DEFINE(telemetry_thread, CONFIG_TELEMETRY_THREAD_STACK_SIZE, telemetry_loop, NULL, NULL, NULL, CONFIG_TELEMETRY_THREAD_PRIORITY, 0, 0);
#endif

#if defined(CONFIG_BLDC) && defined(CONFIG_DT_HAS_ST_STM32_SVPWM_ENABLED)
#include <motor.h>
K_THREAD_DEFINE(motor_thread, CONFIG_MOTOR_THREAD_STACK_SIZE, motor_loop, NULL, NULL, NULL, CONFIG_MOTOR_THREAD_PRIORITY, 0, 0);
#endif

int main(void)
{
#if defined(CONFIG_UART_TRANSPORT)
	int transport_result = uart_transport_start(&comm_uart_transport);

	if (transport_result != 0) {
		LOG_ERR("Failed to start UART transport: %d", transport_result);
		return transport_result;
	}
#endif

	k_sleep(K_FOREVER);
	return 0;
}
```
